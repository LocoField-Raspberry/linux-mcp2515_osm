## drivers/net/can/spi/Kconfig
```kconfig
# SPDX-License-Identifier: GPL-2.0-only
menu "CAN SPI interfaces"
	depends on SPI

config CAN_HI311X
	tristate "Holt HI311x SPI CAN controllers"
	help
	  Driver for the Holt HI311x SPI CAN controllers.

config CAN_MCP251X
	tristate "Microchip MCP251x and MCP25625 SPI CAN controllers"
	help
	  Driver for the Microchip MCP251x and MCP25625 SPI CAN
	  controllers.

config CAN_MCP2515_OSM
	tristate "Microchip MCP2515 SPI CAN controllers (OSM enabled)"
	help
	  Driver for the Microchip MCP2515 SPI CAN controllers.
	  This driver enables One-Shot mode for the MCP2515.

source "drivers/net/can/spi/mcp251xfd/Kconfig"

endmenu
```
